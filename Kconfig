## Kconfig
```kconfig
# Float30 ZMK module Kconfig
source "boards/shields/float30/Kconfig.shield"
source "boards/shields/float30/Kconfig.defconfig"
```

## boards/shields/float30/Kconfig.shield
```kconfig
config SHIELD_FLOAT30_LEFT
    bool "Float30 Left"
    depends on !ZMK_KEYBOARD_SELECT

config SHIELD_FLOAT30_RIGHT
    bool "Float30 Right"
    depends on !ZMK_KEYBOARD_SELECT
```

## config/boards/shields/float34/Kconfig.defconfig
```kconfig
if SHIELD_FLOAT34_LEFT

config ZMK_SPLIT_ROLE_CENTRAL
    default n

endif

if SHIELD_FLOAT34_RIGHT

config ZMK_SPLIT_ROLE_CENTRAL
    default y

endif

if SHIELD_FLOAT34_LEFT || SHIELD_FLOAT34_RIGHT

config ZMK_KEYBOARD_NAME
    default "Float30"

config ZMK_SPLIT
    default y

endif
```

## config/boards/shields/float34/Kconfig.shield
```kconfig
config SHIELD_FLOAT34_LEFT
    bool "Float30 Left"
    depends on !ZMK_KEYBOARD_SELECT

config SHIELD_FLOAT34_RIGHT
    bool "Float30 Right"
    depends on !ZMK_KEYBOARD_SELECT
```

## config/west.yml
```yaml
manifest:
  remotes:
    - name: zmkfirmware
      url-base: https://github.com/zmkfirmware
    - name: petejohanson
      url-base: https://github.com/petejohanson
    - name: inorichi
      url-base: https://github.com/inorichi
  projects:
    - name: zmk
      remote: petejohanson
      revision: feat/pointers-move-scroll
      import: app/west.yml
    - name: zmk-pmw3610-driver
      remote: inorichi
      revision: main
  self:
    path: config
```
